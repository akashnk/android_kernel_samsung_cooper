## drivers/uv/Kconfig
```kconfig
#
# bladeuv module configuration
#

config COOPER_UNDERVOLT
	tristate "COOPER undervolt"
	help
	  Say Y here if you want to build an undervolt module for COOPER

	  If unsure, say N.

	  To compile this module, choose M here: the
	  module will be called cooperuv.
```
